## Blinky/tests/BME280_UNIT_TEST/testcase.yaml
```yaml
tests:
  bme280.unit:
    platform_allow:
      - qemu_cortex_m3
    tags:
      - bme280
      - unit
      - devicetree
    harness: ztest
```

## Blinky/tests/SUM_UNIT_TEST/testcase.yaml
```yaml
tests:
  sum_log.test:
    platform_allow:
      - qemu_cortex_m3
      - nrf7002dk/nrf5340/cpuapp/ns
    tags:
      - sum_log
      - unit
    harness: ztest
```
