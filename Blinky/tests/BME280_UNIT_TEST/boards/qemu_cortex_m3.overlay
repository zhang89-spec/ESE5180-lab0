#include <zephyr/dt-bindings/i2c/i2c.h>

/ {
	fake_i2c: i2c@100 {
		compatible = "zephyr,i2c-emul-controller";
		status = "okay";
		reg = <0x100 0x4>;
		clock-frequency = <I2C_BITRATE_STANDARD>;
		#address-cells = <1>;
		#size-cells = <0>;

		bme280_5180: bme280@77 {
			compatible = "i2c-device";
			reg = <0x77>;
			status = "okay";
		};
	};
};
